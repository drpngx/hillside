## zmk-config/config/boards/shields/hshs46/Kconfig.defconfig
```kconfig
# Copyright (c) 2021-2022 The ZMK Contributors
# SPDX-License-Identifier: MIT

if SHIELD_HSHS46_LEFT

config ZMK_KEYBOARD_NAME
    default "HSHS46"

config ZMK_SPLIT_BLE_ROLE_CENTRAL
    default y

endif

if SHIELD_HSHS46_LEFT || SHIELD_HSHS46_RIGHT

config ZMK_SPLIT
    default y

endif
```

## zmk-config/config/boards/shields/hshs46/Kconfig.shield
```kconfig
# Copyright (c) 2021-2022 The ZMK Contributors
# SPDX-License-Identifier: MIT

config SHIELD_HSHS46_LEFT
    def_bool $(shields_list_contains,hshs46_left)

config SHIELD_HSHS46_RIGHT
    def_bool $(shields_list_contains,hshs46_right)
```
